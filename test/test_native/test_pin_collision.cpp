#include <unity.h>
#include "AppConfig.h"
#include <stdio.h>

void shouldBeCollisionFreeAndSafe() {
    // 1. AUDIO_I2S_DIN_PIN != PRESENCE_SENSOR_PIN
    TEST_ASSERT_NOT_EQUAL_INT_MESSAGE(AUDIO_I2S_DIN_PIN, PRESENCE_SENSOR_PIN, "PIN_MAPPING_COLLISION_DETECTED: AUDIO_I2S_DIN_PIN equals PRESENCE_SENSOR_PIN");

    // 2. AUDIO_I2S_BCLK_PIN != sensor pin
    TEST_ASSERT_NOT_EQUAL_INT_MESSAGE(AUDIO_I2S_BCLK_PIN, DHT_PIN, "PIN_MAPPING_COLLISION_DETECTED: BCLK equals DHT_PIN");
    TEST_ASSERT_NOT_EQUAL_INT_MESSAGE(AUDIO_I2S_BCLK_PIN, I2C_SDA_PIN, "PIN_MAPPING_COLLISION_DETECTED: BCLK equals I2C_SDA_PIN");
    TEST_ASSERT_NOT_EQUAL_INT_MESSAGE(AUDIO_I2S_BCLK_PIN, I2C_SCL_PIN, "PIN_MAPPING_COLLISION_DETECTED: BCLK equals I2C_SCL_PIN");
    TEST_ASSERT_NOT_EQUAL_INT_MESSAGE(AUDIO_I2S_BCLK_PIN, PRESENCE_SENSOR_PIN, "PIN_MAPPING_COLLISION_DETECTED: BCLK equals PRESENCE_SENSOR_PIN");
    TEST_ASSERT_NOT_EQUAL_INT_MESSAGE(AUDIO_I2S_BCLK_PIN, SOUND_SENSOR_PIN, "PIN_MAPPING_COLLISION_DETECTED: BCLK equals SOUND_SENSOR_PIN");

    // 3. AUDIO_I2S_LRC_PIN != sensor pin
    TEST_ASSERT_NOT_EQUAL_INT_MESSAGE(AUDIO_I2S_LRC_PIN, DHT_PIN, "PIN_MAPPING_COLLISION_DETECTED: LRC equals DHT_PIN");
    TEST_ASSERT_NOT_EQUAL_INT_MESSAGE(AUDIO_I2S_LRC_PIN, I2C_SDA_PIN, "PIN_MAPPING_COLLISION_DETECTED: LRC equals I2C_SDA_PIN");
    TEST_ASSERT_NOT_EQUAL_INT_MESSAGE(AUDIO_I2S_LRC_PIN, I2C_SCL_PIN, "PIN_MAPPING_COLLISION_DETECTED: LRC equals I2C_SCL_PIN");
    TEST_ASSERT_NOT_EQUAL_INT_MESSAGE(AUDIO_I2S_LRC_PIN, PRESENCE_SENSOR_PIN, "PIN_MAPPING_COLLISION_DETECTED: LRC equals PRESENCE_SENSOR_PIN");
    TEST_ASSERT_NOT_EQUAL_INT_MESSAGE(AUDIO_I2S_LRC_PIN, SOUND_SENSOR_PIN, "PIN_MAPPING_COLLISION_DETECTED: LRC equals SOUND_SENSOR_PIN");

    // 4. Output pins != GPIO 34 (since GPIO34 is input-only)
    TEST_ASSERT_NOT_EQUAL_INT_MESSAGE(34, HEARTBEAT_LED_PIN, "PIN_MAPPING_COLLISION_DETECTED: HEARTBEAT_LED_PIN is output on GPIO 34");
    TEST_ASSERT_NOT_EQUAL_INT_MESSAGE(34, AUDIO_I2S_BCLK_PIN, "PIN_MAPPING_COLLISION_DETECTED: BCLK is output on GPIO 34");
    TEST_ASSERT_NOT_EQUAL_INT_MESSAGE(34, AUDIO_I2S_LRC_PIN, "PIN_MAPPING_COLLISION_DETECTED: LRC is output on GPIO 34");
    TEST_ASSERT_NOT_EQUAL_INT_MESSAGE(34, AUDIO_I2S_DIN_PIN, "PIN_MAPPING_COLLISION_DETECTED: DIN is output on GPIO 34");

    // 5. Unique pins validation (no reuse unless explicitly declared, all pins must be distinct here)
    int pins[] = {
        HEARTBEAT_LED_PIN,
        DHT_PIN,
        I2C_SDA_PIN,
        I2C_SCL_PIN,
        AUDIO_I2S_BCLK_PIN,
        AUDIO_I2S_LRC_PIN,
        AUDIO_I2S_DIN_PIN,
        PRESENCE_SENSOR_PIN,
        SOUND_SENSOR_PIN
    };
    int n = sizeof(pins) / sizeof(pins[0]);
    for (int i = 0; i < n; i++) {
        for (int j = i + 1; j < n; j++) {
            if (pins[i] == pins[j]) {
                char buffer[128];
                snprintf(buffer, sizeof(buffer), "PIN_MAPPING_COLLISION_DETECTED: Duplicate pin GPIO %d", pins[i]);
                TEST_FAIL_MESSAGE(buffer);
            }
        }
    }

    printf("PIN_MAPPING_VALIDATED\n");
}
